## config/west.yml
```yaml
manifest:
  remotes:
    - name: zmkfirmware
      url-base: https://github.com/zmkfirmware
    - name: ZitaoTech
      url-base: https://github.com/ZitaoTech
    - name: KyleBing
      url-base: https://github.com/KyleBing
  projects:
    - name: zmk
      remote: KyleBing
      revision: bbkeyboard_tp-q10-modes
      import: app/west.yml
  self:
    path: config
```
